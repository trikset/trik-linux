## drivers/trik/Kconfig
```kconfig
#
# Platform device specific infrastructure for Trik jacks 
#
menuconfig TRIK_PLATFORM_DEVICES
	tristate "Trik platfrom drivers for specific ports"if EXPERT
	default n

if TRIK_PLATFORM_DEVICES

comment "Ports"

source "drivers/trik/jd1/Kconfig"
source "drivers/trik/jd2/Kconfig"
comment "Sensors"

source "drivers/trik/sensors/Kconfig"

endif
	
```

## drivers/trik/jcx/Kconfig
```kconfig
config TRIK_JCX_PWM
	tristate "TRIK JCX ports platform driver for pwm support"
	default n
```

## drivers/trik/jd1/Kconfig
```kconfig
config TRIK_JD1_HCSR04
	tristate "TRIK JD1 port platform driver for hcsr04 driver"
	default n
```

## drivers/trik/jd2/Kconfig
```kconfig
config TRIK_JD2_HCSR04
	tristate "Trik JD2 port platform driver for hcsr04 driver"
	default n
```

## drivers/trik/jex/Kconfig
```kconfig
config TRIK_JEX_PWM
	tristate "Trik JCX ports platform driver for pwm support"
	default n
	
```

## drivers/trik/jf1/Kconfig
```kconfig
config TRIK_JF1_HCSR04
	tristate "TRIK JF1 port platform driver for hcsr04 driver"
	default n
```

## drivers/trik/jx2/Kconfig
```kconfig
config TRIK_JX2_GPIO
	tristate "TRIK JX2 port platform driver for GPIO pins"
	default n
```
